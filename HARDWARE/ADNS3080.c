//20141222
#include "spi.h"
#include "ADNS3080.h"
#include "usart.h"
#include <math.h>
#include "SysTick.h"
#include "24l01.h"

int8_t motion_reg,raw_dx,raw_dy,g_A3080_dx=0,g_A3080_dy=0,_overflow;
uint8_t surface_quality;

#if OPFLOW_SENSOR_ONBOARD_SPI_EN
uint8_t SROM[1986];

/********************************
函数：ADNS3080_delay_us
功能：延时接口函数,
输入：微秒数，
输出：-
修改：20141222
***********************************/
void ADNS3080_delay_us(uint16_t time)
{
//	Delay_10us(time/5);
//	delay_us(time);
	delay_nus(time);
}


/********************************
函数：ADNS3080_GPIOInit
功能：初始化ADNS3080的IO口
输入：-
输出：-
修改：20141115
***********************************/
void ADNS3080_GPIOInit(void)
	{
	GPIO_InitTypeDef GPIO_InitStructure;
  //使能PORTA口时钟 
  //使能PORTB口时钟 
	RCC_APB2PeriphClockCmd(	ADNS3080_RST_CLK|ADNS3080_NCS_CLK, ENABLE );
		
	GPIO_InitStructure.GPIO_Pin = ADNS3080_NCS_PIN;
	GPIO_InitStructure.GPIO_Mode = GPIO_Mode_Out_PP ;   //推挽输出
	GPIO_InitStructure.GPIO_Speed = GPIO_Speed_50MHz;
	GPIO_Init(ADNS3080_NCS_PORT, &GPIO_InitStructure);
		
	GPIO_InitStructure.GPIO_Pin = ADNS3080_RST_PIN;
	GPIO_InitStructure.GPIO_Mode = GPIO_Mode_Out_PP ;   //推挽输出GPIO_Mode_Out_OD
	GPIO_InitStructure.GPIO_Speed = GPIO_Speed_50MHz;
	GPIO_Init(ADNS3080_RST_PORT, &GPIO_InitStructure);		
	Clr_ADNS3080_RST;		
#if ADNS3080_POWER_DOWN_CTL	
	RCC_APB2PeriphClockCmd(	ADNS3080_NPD_CLK, ENABLE );	
		
	GPIO_InitStructure.GPIO_Pin = ADNS3080_NPD_PIN;
	GPIO_InitStructure.GPIO_Mode = GPIO_Mode_Out_PP ;   //推挽输出
	GPIO_InitStructure.GPIO_Speed = GPIO_Speed_50MHz;
	GPIO_Init(ADNS3080_NPD_PORT, &GPIO_InitStructure);
	Set_ADNS3080_NPD;									//close power down mode
#endif		
				
	}
/********************************
函数：ADNS3080_Reset
功能：复位ADNS3080
输入：-
输出：-
复位只改变模式，不改变寄存器配置	
修改：20141115
***********************************/
void ADNS3080_Reset()
{
	Set_ADNS3080_RST;
	ADNS3080_delay_us(20);
	Clr_ADNS3080_RST;					

}	


/********************************
函数：ADNS3080_WriteRegister
功能：ADNS3080写寄存器
输入：address 寄存器地址，value 值
输出：-
修改：20141115
***********************************/
void ADNS3080_WriteRegister(uint8_t address, uint8_t value)	
{
	u8 status;	
	Clr_ADNS3080_NCS;          //使能SPI传输
#if ADNS3080_USE_SPI1	
	status =SPI1_ReadWriteByte(address|0x80);//发送寄存器号
	SPI1_ReadWriteByte(value);      //写入寄存器的值
	
#elif ADNS3080_USE_SPI2
	status =SPI2_ReadWriteByte(address|0x80);//发送寄存器号 
	SPI2_ReadWriteByte(value);      //写入寄存器的值
#endif	
	Set_ADNS3080_NCS;          //禁止SPI传输		    
}

/********************************
函数：ADNS3080_Burst_Write
功能：ADNS3080爆写
输入：address 寄存器地址，value 值	,len数据长度
输出：-
修改：20141221
***********************************/
void ADNS3080_Burst_Write(uint8_t address, uint8_t *str, uint16_t len)	
{
	u8 status;
	uint16_t i;
	Clr_ADNS3080_NCS;          //使能SPI传输
	
#if ADNS3080_USE_SPI1	
	status =SPI1_ReadWriteByte(address|0x80);//发送寄存器号 
#elif ADNS3080_USE_SPI2
	status =SPI2_ReadWriteByte(address|0x80);//发送寄存器号 
#endif		
	ADNS3080_delay_us(10);
	for(i=0;i<len;i++)
	{
#if ADNS3080_USE_SPI1	
		status =SPI1_ReadWriteByte(*str);//发送寄存器号 
#elif ADNS3080_USE_SPI2
		status =SPI2_ReadWriteByte(*str);//发送寄存器号 
#endif	
		str++;
		ADNS3080_delay_us(10);
	}
	Set_ADNS3080_NCS;          //禁止SPI传输		    
}

/********************************
函数：ADNS3080_ReadRegister
功能：ADNS3080写寄存器
输入：寄存器地址
输出：寄存器值
修改：20141115
***********************************/
u8 ADNS3080_ReadRegister(uint8_t address)
{
	u8 reg_val=1;	    
	Clr_ADNS3080_NCS;          //使能SPI传输
#if ADNS3080_USE_SPI1	
	reg_val=SPI1_ReadWriteByte(address);   //发送寄存器号
#elif ADNS3080_USE_SPI2
	reg_val=SPI2_ReadWriteByte(address);   //发送寄存器号
#endif	
	if(address==ADNS3080_MOTION)
	ADNS3080_delay_us(75);
	else
	ADNS3080_delay_us(50);
#if ADNS3080_USE_SPI1	
	reg_val=SPI1_ReadWriteByte(0X00);   //发送寄存器号
#elif ADNS3080_USE_SPI2
	reg_val=SPI2_ReadWriteByte(0X00);   //发送寄存器号
#endif	
	Set_ADNS3080_NCS;          //禁止SPI传输		    
	return(reg_val);           //返回状态值
}


/********************************
函数：ADNS3080_Get_Frame_Rate
功能：ADNS3080获取帧率
输入：-
输出：帧率值
修改：20141115
***********************************/
u16 ADNS3080_Get_Frame_Rate()
{	
	union NumericIntType period;
	uint16_t rate;
	uint32_t clockSpeed = ADNS3080_CLOCK_SPEED;
	period.byteValue[1]=ADNS3080_ReadRegister(ADNS3080_FRAME_PERIOD_UPPER); 	//读出写入的地址  
	ADNS3080_delay_us(50);
 	period.byteValue[0]=ADNS3080_ReadRegister(ADNS3080_FRAME_PERIOD_LOWER); 	
    rate = clockSpeed / period.uintValue;
    return rate;
}


/********************************
函数：ADNS3080_Get_Frame_Rate_Auto
功能：获取帧率模式
输入：-
输出：帧率的模式，0自动，1手动
修改：20141115
***********************************/
u8 ADNS3080_Get_Frame_Rate_Auto()
{
	u8 ret;
	ret=ADNS3080_ReadRegister(ADNS3080_EXTENDED_CONFIG);
	if(ret&0x01)				///手动
		return 1;
	else return 0;				//自动
}



/********************************
函数：ADNS3080_Get_Frame_Rate_Limit_Max
功能：ADNS3080获取最大帧率限制
输入：-
输出：帧率值
修改：20141221
***********************************/
u16 ADNS3080_Get_Frame_Rate_Limit_Max()
{	
	union NumericIntType period;
	uint16_t rate;
	uint32_t clockSpeed = ADNS3080_CLOCK_SPEED;
	period.byteValue[1]=ADNS3080_ReadRegister(ADNS3080_FRAME_PERIOD_MAX_BOUND_UPPER); 	//读出写入的地址  
	ADNS3080_delay_us(50);
 	period.byteValue[0]=ADNS3080_ReadRegister(ADNS3080_FRAME_PERIOD_MAX_BOUND_LOWER); 	
    rate = clockSpeed / period.uintValue;
    return rate;
}

/********************************
函数：ADNS3080_Get_Frame_Rate_Limit_Min
功能：ADNS3080获取最小帧率限制
输入：-
输出：帧率值
修改：20141221
***********************************/
u16 ADNS3080_Get_Frame_Rate_Limit_Min()
{	
	union NumericIntType period;
	uint16_t rate;
	uint32_t clockSpeed = ADNS3080_CLOCK_SPEED;
	period.byteValue[1]=ADNS3080_ReadRegister(ADNS3080_FRAME_PERIOD_MIN_BOUND_UPPER); 	//读出写入的地址  
	ADNS3080_delay_us(50);
 	period.byteValue[0]=ADNS3080_ReadRegister(ADNS3080_FRAME_PERIOD_MIN_BOUND_LOWER); 	
    rate = clockSpeed / period.uintValue;
	
    return rate;
}



/********************************
函数：ADNS3080_Get_Resolution
功能：获取分辨率配置
输入：-
输出：分辨率值
修改：20141115
***********************************/
// returns resolution (either 400 or 1600 counts per inch)
uint16_t ADNS3080_Get_Resolution()
{
    if( (ADNS3080_ReadRegister(ADNS3080_CONFIGURATION_BITS) & 0x10) == 0 )
        return 400;
    else
        return 1600;		
}

/********************************
函数：ADNS3080_Get_Shutter_Speed
功能：获取快门速度
输入：-
输出：快门速度
修改：20141115
***********************************/
uint16_t ADNS3080_Get_Shutter_Speed()
{
    union NumericIntType aNum;
    aNum.byteValue[1] = ADNS3080_ReadRegister(ADNS3080_SHUTTER_UPPER);
	ADNS3080_delay_us(50);
    aNum.byteValue[0] = ADNS3080_ReadRegister(ADNS3080_SHUTTER_LOWER);
    return aNum.uintValue;
}

/********************************
函数：ADNS3080_Get_Shutter_Speed_Auto
功能：获取快门速度模式
输入：-
输出：快门速度模式 0自动， 1手动
修改：20141115
***********************************/
// get_shutter_speed_auto - returns true if shutter speed is adjusted
// automatically, false if manual
u8 ADNS3080_Get_Shutter_Speed_Auto()
{
    uint8_t regVal = ADNS3080_ReadRegister(ADNS3080_EXTENDED_CONFIG);
    if( (regVal & 0x02) > 0 ) {
        return 1;		//手动
    }else{
        return 0;		//自动
    }
}

/********************************
函数：ADNS3080_Get_Shutter_Limit_Max
功能：ADNS3080获取最大快门限制
输入：-
输出：快门值
修改：20141221
***********************************/
u16 ADNS3080_Get_Shutter_Limit_Max()
{	
	union NumericIntType period;
	uint16_t rate;
	uint32_t clockSpeed = ADNS3080_CLOCK_SPEED;
	period.byteValue[1]=ADNS3080_ReadRegister(ADNS3080_SHUTTER_MAX_BOUND_UPPER); 	//读出写入的地址  
	ADNS3080_delay_us(50);
 	period.byteValue[0]=ADNS3080_ReadRegister(ADNS3080_SHUTTER_MAX_BOUND_LOWER); 	
    rate = clockSpeed / period.uintValue;
    return rate;
}


/********************************
函数：ADNS3080_DownloadSROM
功能：下载SROM固件
输入：-
输出：快门速度
修改：20141115
***********************************/
void ADNS3080_DownloadSROM()
{
	ADNS3080_Reset();
	ADNS3080_delay_us(100);
	ADNS3080_WriteRegister(0x20,0x44);
	ADNS3080_delay_us(50);
    ADNS3080_WriteRegister(0x23,0x07);
	ADNS3080_delay_us(50);
    ADNS3080_WriteRegister(0x24,0x88); 
	ADNS3080_delay_us(200);
	ADNS3080_WriteRegister(ADNS3080_SROM_ENABLE,0x18);
	ADNS3080_delay_us(50);
	ADNS3080_Burst_Write(ADNS3080_SROM_LOAD,SROM,1986);
	ADNS3080_delay_us(100);
//	ADNS3080_Reset();	//复位会丢失SROM

}


/********************************
函数：ADNS3080_Check
功能：检测ADNS3080的存在，并打印其参数配置
输入：-
返回值:false，成功;true，失败	
修改：20141115
***********************************/
bool ADNS3080_Check(void)
	{
	u8 ret;	
	u16 ret16;	
	ret=ADNS3080_ReadRegister(ADNS3080_PRODUCT_ID); 	//读出写入的地址  
	if(ret!=0x17)
	{
		printf("There is no ADNS3080 on the bus\r\n");
		return FALSE;				//检测ADNS3080错误	
	}
	else printf("ADNS3080 is found,ID:0x%x\r\n",ret);
	ret=ADNS3080_ReadRegister(ADNS3080_SROM_ID);
	while(ret==0)
	{
		printf("ADNS3080 SROM_ID:0x%x,start download SROM..\r\n",ret);
		ADNS3080_DownloadSROM();
		ret=ADNS3080_ReadRegister(ADNS3080_SROM_ID);
		ADNS3080_delay_us(1000);
	}
	printf("ADNS3080 SROM_ID:0x%x,has SROM\r\n",ret);
	ret=ADNS3080_ReadRegister(ADNS3080_REVISION_ID);
	printf("ADNS3080 revisionID:0x%x\r\n",ret);
	ret=ADNS3080_ReadRegister(ADNS3080_CONFIGURATION_BITS);
	printf("ADNS3080 config_bits:0x%x\r\n",ret);
	ret=ADNS3080_ReadRegister(ADNS3080_EXTENDED_CONFIG);
	printf("ADNS3080 extended_config:0x%x\r\n",ret);
	ret16=ADNS3080_Get_Frame_Rate();
	printf("ADNS3080 Frame_Rate: %d\r\n",ret16);
	ret16=ADNS3080_Get_Frame_Rate_Limit_Max();
	printf("ADNS3080 Max Frame_Rate: %d\r\n",ret16);
	ret16=ADNS3080_Get_Frame_Rate_Limit_Min();
	printf("ADNS3080 Min Frame_Rate: %d\r\n",ret16);
	ret=ADNS3080_Get_Frame_Rate_Auto();
	printf("Frame_Rate_Auto/0,manual/1:0x%x\r\n",ret);
	ret16=ADNS3080_Get_Resolution();
	printf("ADNS3080_Get_Resolution: %d\r\n",ret16);
	ret16=ADNS3080_Get_Shutter_Speed();
	printf("Frame_Rate_Auto/0,manual:0x%x\r\n",ret);
	ret16=ADNS3080_Get_Shutter_Limit_Max();
	printf("ADNS3080 Max Shutter: %d\r\n",ret16);
	ret=ADNS3080_Get_Shutter_Speed_Auto();
	printf("ADNS3080_Get_Shutter_Speed_Auto/0,manual/1:0x%x\r\n",ret);
	
	return TRUE;		 				//检测到ADNS3080
	}	

/********************************
函数：ADNS3080_SPIInit
功能：初始化ADNS3080的SPI接口和IO口
输入：-
输出：-
修改：20141222
//	switch(i)	//spi速度为281.25Khz （ADNS3080的最大SPI时钟为4Mhz）
//	{
//		case 5:{SPIx_SetSpeed(SPI_SPEED_16);i-- ;printf("i=5,");}break;	//4.5MHz 太快
//		case 4:{SPIx_SetSpeed(SPI_SPEED_32);i-- ;printf("i=4,");}break;
//		case 3:{SPIx_SetSpeed(SPI_SPEED_64);i-- ;printf("i=3,");}break;
//		case 2:{SPIx_SetSpeed(SPI_SPEED_128);i--;printf("i=2,");}break;
//		case 1:{SPIx_SetSpeed(SPI_SPEED_256);i=5;printf("i=1,");}break;
//		default :break;
//	}
***********************************/	
void ADNS3080_SPIInit()
{	
//	static u8	i=5;
	ADNS3080_GPIOInit();
#if ADNS3080_USE_SPI1	
	SPI1_Init();						//（ADNS3080的最大SPI时钟约为4Mhz） 
	SPI1_SetSpeed(SPI_SPEED_32); 		//spi速度为2.25Mhz （ADNS3080的最大SPI时钟为4Mhz）
#elif ADNS3080_USE_SPI2
	SPI2_Init();						//（ADNS3080的最大SPI时钟约为4Mhz） 
	SPI2_SetSpeed(SPI_SPEED_32); 		//spi速度为2.25Mhz （ADNS3080的最大SPI时钟为4Mhz）
#endif	
	ADNS3080_delay_us(400);	
}

/********************************
函数：ADNS3080_DeviceInit
功能：初始化ADNS3080芯片
输入：-
输出：TRUE 初始化成功， FALSE 初始化失败
修改：20141115
***********************************/
bool ADNS3080_DeviceInit()
{
//    int8_t retry = 0;
    bool retvalue = FALSE;

	ADNS3080_Reset();
	ADNS3080_delay_us(400);
	retvalue=ADNS3080_Check();
	
	return retvalue;
}


/********************************
函数：ADNS3080_Update
功能：读取位移增量值
输入：-
输出：-
修改：20141115
***********************************/
// read latest values from sensor and fill in x,y and totals
void ADNS3080_Update(void)
{
    surface_quality = ADNS3080_ReadRegister(ADNS3080_SQUAL);
	ADNS3080_delay_us(50);

    // check for movement, update x,y values
    motion_reg = ADNS3080_ReadRegister(ADNS3080_MOTION);
    // check if we've had an overflow
    _overflow = ((motion_reg & 0x10) != 0);
	
    if( (motion_reg & 0x80) != 0)// &&_overflow) 
	{
        raw_dx = ((int8_t)ADNS3080_ReadRegister(ADNS3080_DELTA_X));
		ADNS3080_delay_us(50);
        raw_dy = ((int8_t)ADNS3080_ReadRegister(ADNS3080_DELTA_Y));
    }else{
        raw_dx = 0;
        raw_dy = 0;
    }
	g_A3080_dx = raw_dx;
	g_A3080_dy = raw_dy;
}


/********************************
函数：ADNS3080_Clear_Motion
功能：ADNS3080清理运动寄存器
输入：-
输出：-
修改：20141115
***********************************/
// clear_motion - will cause the Delta_X, Delta_Y, and internal motion
// registers to be cleared
void ADNS3080_Clear_Motion()
{
    // writing anything to this register will clear the sensor's motion
    // registers
    ADNS3080_WriteRegister(ADNS3080_MOTION_CLEAR,0xFF); 
}


/********************************
函数：ADNS3080_Print_Pixel_Data
功能：读取一帧图像
输入：-
输出：-
修改：20141115
***********************************/
// get_pixel_data - captures an image from the sensor and stores it to the
// pixe_data array
void ADNS3080_Print_Pixel_Data()
{
    int16_t i,j;
//    u8 firstpixel = 1;
    uint8_t regValue;
    uint8_t pixelValue;
	uint8_t pixeldata[10] = {0};
	static u8 cnt = 0;

    // write to frame capture register to force capture of frame
    ADNS3080_WriteRegister(ADNS3080_FRAME_CAPTURE,0x83);

    // wait 3 frame periods + 10 nanoseconds for frame to be captured
    // min frame speed is 2000 frames/second so 1 frame = 500 nano seconds.
    // so 500 x 3 + 10 = 1510
	ADNS3080_delay_us(1510);

    // display the pixel data
    for( i=0; i<ADNS3080_PIXELS_Y; i++ ) {
        for( j=0; j<ADNS3080_PIXELS_X; j++ ) {
            regValue = ADNS3080_ReadRegister(ADNS3080_FRAME_CAPTURE);
            pixelValue = ( regValue << 2 );
			pixeldata[cnt++]=pixelValue;
			if(cnt==10)
			{
				cnt = 0;
				NRF24L01_TxPacket(pixeldata,10);
			}
//            printf("%3d",pixelValue);
			ADNS3080_delay_us(50);
        }
    }

    // hardware reset to restore sensor to normal operation
    ADNS3080_Reset();
}



//version 0x51;
uint8_t SROM[1986]={
0xe6,0xff,0x40,0x22,0x86,0xaa,0x9f,0x73,0xdc,0x34,0x5f,0x1d,0x0d,0x05,0xe2,0xae,
0x5c,0xe7,0x5e,0x67,0x2f,0xd2,0x45,0xaa,0xb7,0x2d,0xf9,0x71,0xc0,0xe2,0x89,0x8f,
0x18,0xc0,0x50,0xb1,0x4c,0x5b,0x1e,0xb3,0x53,0x32,0x56,0x3a,0x14,0xe7,0x64,0x58,
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0x00,0x88};

#endif //#if OPFLOW_SENSOR_ONBOARD_SPI_EN
