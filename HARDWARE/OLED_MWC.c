
/************************
MS5611.c
20141112
Dammstanger
// ########################################
// #  i2c OLED display funtion primitives #
// ########################################
*****************************/

#include "OLED_MWC.h"
#include "I2C_1.h"
#include <math.h>
#include "usart.h"
#include <stdio.h>
#include "SysTick.h"

//#define SUPPRESS_OLED_I2C_128x64LOGO
char DispData[10] ={0};
const uint8_t myFont[][5];
//const uint8_t LOGO[];
static char buffer; 
unsigned char CHAR_FORMAT = 0;      // use to INVERSE characters


////////////////////////////////////////////////////////////////////
//  void LCDattributesBold() {/*CHAR_FORMAT = 0b01111111; */}
//  void LCDattributesReverse() {CHAR_FORMAT = 0b01111111; }
//  void LCDattributesOff() {CHAR_FORMAT = 0; }
//  void LCDalarmAndReverse() {LCDattributesReverse(); }
////////////////////////////////////////////////////////////////////


/********************************
函数：OLED_MWC_send_cmd
功能：送入命令
输入：命令值
输出：-
修改：20141112
***********************************/
bool OLED_MWC_send_cmd(uint8_t command)
{
	bool retval;
  retval = IIC1_WriteByte(OLED_ADDRESS, 0x80, (uint8_t)command);
	return retval;
}

/********************************
函数：OLED_MWC_send_cmd
功能：送入命令
输入：命令值
输出：-
修改：20141112
***********************************/
void OLED_MWC_send_byte(uint8_t val) {
	IIC1_WriteByte(OLED_ADDRESS, 0x40, (uint8_t)val);
}


/********************************
函数：OLED_MWC_send_cmd
功能：送入命令
输入：命令值
输出：-
修改：20141112
***********************************/
bool  OLED_MWC_init(void){
	bool retval;
	retval=OLED_MWC_send_cmd(0xae);    //display off
	if(retval==FALSE) return retval;
	OLED_MWC_send_cmd(0xa4);          //SET All pixels OFF
	//  OLED_MWC_send_cmd(0xa5);            //SET ALL pixels ON
	Delay_ms(50);
	OLED_MWC_send_cmd(0x20);            //Set Memory Addressing Mode
	OLED_MWC_send_cmd(0x02);            //Set Memory Addressing Mode to Page addressing mode(RESET)
	//  OLED_MWC_send_cmd(0xa0);      //colum address 0 mapped to SEG0 (POR)*** wires at bottom
	OLED_MWC_send_cmd(0xa1);    //colum address 127 mapped to SEG0 (POR) ** wires at top of board
	//  OLED_MWC_send_cmd(0xC0);            // Scan from Right to Left (POR)         *** wires at bottom
	OLED_MWC_send_cmd(0xC8);          // Scan from Left to Right               ** wires at top
	OLED_MWC_send_cmd(0xa6);            // Set WHITE chars on BLACK backround
	//  OLED_MWC_send_cmd(0xa7);            // Set BLACK chars on WHITE backround
	OLED_MWC_send_cmd(0x81);            // Setup CONTRAST CONTROL, following byte is the contrast Value
	OLED_MWC_send_cmd(0xaf);            // contrast value between 1 ( == dull) to 256 ( == bright)
	//  OLED_MWC_send_cmd(0xd3);            // Display Offset :
	//  OLED_MWC_send_cmd(0x0);            // 0
	//  Delay_ms(20);
	//  OLED_MWC_send_cmd(0x40);            // Display start line [0;63] -> [0x40;0x7f]
	//  Delay_ms(20);
	#ifdef DISPLAY_FONT_DSIZE
	OLED_MWC_send_cmd(0xd6);            // zoom
	OLED_MWC_send_cmd(0x01);            // on
	#else
	//    OLED_MWC_send_cmd(0xd6);            // zoom
	//    OLED_MWC_send_cmd(0x00);            // off
	#endif
	Delay_ms(20);
	OLED_MWC_send_cmd(0xaf);          //display on
	OLED_MWC_Clear();
	Delay_ms(20);
	return TRUE;
}

/********************************
函数：OLED_MWC_send_cmd
功能：送入命令
输入：命令值
输出：-
修改：20141112
***********************************/
void OLED_MWC_Clear(void)
{
  u16 i;
//  for(i=0;i<8;i++){
//    OLED_MWC_set_XY(0,i);
//    OLED_MWC_send_string(LINE_FILL_STRING);
//  }
  OLED_MWC_send_cmd(0xa6);              //Set Normal Display
  OLED_MWC_send_cmd(0xae);              // Display OFF
  OLED_MWC_send_cmd(0x20);              // Set Memory Addressing Mode
  OLED_MWC_send_cmd(0x00);              // Set Memory Addressing Mode to Horizontal addressing mode
  OLED_MWC_send_cmd(0xb0);              // set page address to 0
  OLED_MWC_send_cmd(0X40);              // Display start line register to 0
  OLED_MWC_send_cmd(0);                 // Set low col address to 0
  OLED_MWC_send_cmd(0x10);              // Set high col address to 0
  for(i=0; i<1024; i++) {           // fill the display's RAM with graphic... 128*64 pixel picture
     OLED_MWC_send_byte(0);  // clear
  }
  OLED_MWC_send_cmd(0x81);              // Setup CONTRAST CONTROL, following byte is the contrast Value... always a 2 byte instruction
  OLED_MWC_send_cmd(200);               // Here you can set the brightness 1 = dull, 255 is very bright
  OLED_MWC_send_cmd(0xaf);              // display on
}

/********************************
函数：OLED_MWC_set_XY
功能：设置显示坐标
输入：列值：1-21  21个字符 行值：1-8	共8行
输出：-
修改：20141112
备注：列地址是这样的：|0_低地址_f|________|________|________|________|________|________|________| 128个点
						高地址0															高地址7						

***********************************/
void OLED_MWC_set_XY(u8 col, u8 row) 
{   u8 l=0,h=0;     										//  Not used in MW V2.0 but its here anyway!
	col-=1;
	row-=1;
	OLED_MWC_send_cmd(0xb0+row);                //set page address
//	OLED_MWC_send_cmd(0x00+(8*col&0x0f));       //set low col address
//	OLED_MWC_send_cmd(0x10+((8*col>>4)&0x0f));  //set high col address
	col*=6;
	l=col%0x0f;
	h=col/0x10;
	OLED_MWC_send_cmd(l);
	OLED_MWC_send_cmd(0x10|h);
//	OLED_MWC_send_cmd(0x2f);  //实现了右移
}


/********************************
函数：OLED_MWC_set_line
功能：设置显示起始行
输入：起始行值1-8	共8行
输出：-
修改：20141112
***********************************/
void OLED_MWC_set_line(u8 row)
{   								// goto the beginning of a single row, compattible with LCD_CONFIG
	row=row-1;
	OLED_MWC_send_cmd(0xb0+row);     //set page address
	OLED_MWC_send_cmd(0);            //set low col address
	OLED_MWC_send_cmd(0x10);         //set high col address
}

/********************************
函数：OLED_MWC_send_char
功能：显示一个字符
输入：字符的ASCII码
输出：-
修改：20141112
***********************************/
void OLED_MWC_send_char(unsigned char ascii){
  unsigned char i;
  for(i=0;i<5;i++){
    buffer = myFont[ascii - 32][i]; // call the macro to read ROM byte and put it in buffer
    buffer ^= CHAR_FORMAT;  // apply
    OLED_MWC_send_byte(buffer);
  }
  OLED_MWC_send_byte(CHAR_FORMAT);    // the gap
}



/********************************
函数：OLED_MWC_send_string
功能：显示字符串
输入：字符数组地址
输出：-
修改：20141112
***********************************/
void OLED_MWC_send_string(const char *string){  // Sends a string of chars untill null terminator
  unsigned char i=0;
  while(*string){
    for(i=0;i<5;i++){
      buffer = myFont[(*string)- 32][i]; // call the macro to read the ROM ASCII table
      buffer ^= CHAR_FORMAT;
      OLED_MWC_send_byte((unsigned char)buffer);
    }
    OLED_MWC_send_byte(CHAR_FORMAT);    // the gap
    string++;
  }
}


void PrintDebugDat_OLED(int dat1,int dat2,int dat3,int dat4,char *str)
{
//	sprintf(DispData,"%4d %4d %4d %4d",dat1,dat2,dat3,dat4);
//	OLED_MWC_set_XY(1,2);
//	OLED_MWC_send_string(DispData);
	
	sprintf(DispData,"%4d %4d",dat1,dat2);
	OLED_MWC_set_XY(1,2);
	OLED_MWC_send_string(DispData);
}



#if 0
/********************************
函数：OLED_MWC_send_logo
功能：//logo闪烁显示logo
输入：-
输出：-
修改：20141112
***********************************/

void OLED_MWC_send_logo(void){
	unsigned char i,j;
	u16 k;
	OLED_MWC_send_cmd(0xa6);              //Set Normal Display
	OLED_MWC_send_cmd(0xae);      // Display OFF
	OLED_MWC_send_cmd(0x20);              // Set Memory Addressing Mode
	OLED_MWC_send_cmd(0x00);              // Set Memory Addressing Mode to Horizontal addressing mode
	OLED_MWC_send_cmd(0xb0);              // set page address to 0
	OLED_MWC_send_cmd(0X40);              // Display start line register to 0
	OLED_MWC_send_cmd(0);                 // Set low col address to 0
	OLED_MWC_send_cmd(0x10);              // Set high col address to 0
	for(k=0; k<1024; k++) 
	{          // fill the display's RAM with graphic... 128*64 pixel picture
		buffer = LOGO[k];
		OLED_MWC_send_byte(buffer);
	}
	OLED_MWC_send_cmd(0x81);             // Setup CONTRAST CONTROL, following byte is the contrast Value... always a 2 byte instruction
	OLED_MWC_send_cmd(0x0);              // Set contrast value to 0
	OLED_MWC_send_cmd(0xaf);           // display on
	for(j=0; j<2; j++)
	{
		for(i=0x01; i<0xff; i++)
		{
		  OLED_MWC_send_cmd(0x81);         // Setup CONTRAST CONTROL, following byte is the contrast Value
		  OLED_MWC_send_cmd(i);            // Set contrast value
		  Delay_ms(1);
		}
		for(i=0xff; i>0x01; i--)
		{
		  OLED_MWC_send_cmd(0x81);         // Setup CONTRAST CONTROL, following byte is the contrast Value
		  OLED_MWC_send_cmd(i);            // Set contrast value
		  Delay_ms(1);
		}
	}
	OLED_MWC_init();
//	OLED_MWC_Clear();
}



/********************************
函数：OLED_MWC_Put_Logo
功能：//永久显示Logo
输入：-
输出：-
修改：20141112
***********************************/

void OLED_MWC_Put_Logo(void){
  unsigned int i;
  OLED_MWC_send_cmd(0xa6);              //Set Normal Display
  OLED_MWC_send_cmd(0xae);              // Display OFF
  OLED_MWC_send_cmd(0x20);              // Set Memory Addressing Mode
  OLED_MWC_send_cmd(0x00);              // Set Memory Addressing Mode to Horizontal addressing mode
  OLED_MWC_send_cmd(0xb0);              // set page address to 0
  OLED_MWC_send_cmd(0X40);              // Display start line register to 0
  OLED_MWC_send_cmd(0);                 // Set low col address to 0
  OLED_MWC_send_cmd(0x10);              // Set high col address to 0
  for(i=0; i<1024; i++) {           // fill the display's RAM with graphic... 128*64 pixel picture
    buffer = LOGO[i];
    OLED_MWC_send_byte(buffer);
  }
  OLED_MWC_send_cmd(0x81);              // Setup CONTRAST CONTROL, following byte is the contrast Value... always a 2 byte instruction
  OLED_MWC_send_cmd(250);               // Here you can set the brightness 1 = dull, 255 is very bright
  OLED_MWC_send_cmd(0xaf);              // display on
}
#endif
/********************************
字库
修改：20141112
***********************************/
const uint8_t myFont[][5] = { // Refer to "Times New Roman" Font Database... 5 x 7 font
  { 0x00,0x00,0x00,0x00,0x00},
  { 0x00,0x00,0x4F,0x00,0x00}, //   (  1)  ! - 0x0021 Exclamation Mark
  { 0x00,0x07,0x00,0x07,0x00}, //   (  2)  " - 0x0022 Quotation Mark
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  { 0x7E,0x7E,0x7E,0x7E,0x7E}, //   (127)    - 0x00BF Bargraph - 5
};

#if 0
/********************************
// logo....Multiwill
修改：20141112
***********************************/
const uint8_t LOGO[] = { 
    0x00, 0x00, 0x02, 0xFE, 0xFE, 0x0E, 0xFC, 0xF8, 0xC0, 0x00, 0xC0, 0xF8, 0xFC, 0x0E, 0xFE, 0xFE,
    0xFE, 0x02, 0x00, 0x00, 0x30, 0xF0, 0xF0, 0x00, 0x00, 0x00, 0x30, 0xF0, 0xF0, 0x00, 0x00, 0x00,
    0x02, 0xFE, 0xFE, 0x00, 0x00, 0x00, 0x30, 0xF8, 0xFE, 0x30, 0x30, 0x30, 0x00, 0x00, 0x30, 0xF6,
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    0x22, 0x21, 0x20, 0x00, 0x00, 0x0E, 0x11, 0x20, 0x20, 0x20, 0x11, 0x0E, 0x00, 0x00, 0x00, 0x00

};

#endif
